## kernel/config/linux-6.1/tinyvision_debian_defconfig
```kconfig
# CONFIG_LOCALVERSION_AUTO is not set
CONFIG_SYSVIPC=y
CONFIG_NO_HZ=y
CONFIG_HIGH_RES_TIMERS=y
CONFIG_PREEMPT=y
CONFIG_BSD_PROCESS_ACCT=y
CONFIG_BSD_PROCESS_ACCT_V3=y
CONFIG_IKCONFIG=y
CONFIG_IKCONFIG_PROC=y
CONFIG_LOG_BUF_SHIFT=14
CONFIG_CGROUPS=y
CONFIG_CGROUP_FAVOR_DYNMODS=y
CONFIG_MEMCG=y
CONFIG_BLK_CGROUP=y
CONFIG_CGROUP_SCHED=y
CONFIG_CFS_BANDWIDTH=y
CONFIG_RT_GROUP_SCHED=y
CONFIG_CGROUP_PIDS=y
CONFIG_CGROUP_RDMA=y
CONFIG_CGROUP_FREEZER=y
CONFIG_CGROUP_DEVICE=y
CONFIG_CGROUP_CPUACCT=y
CONFIG_CGROUP_PERF=y
CONFIG_CGROUP_MISC=y
CONFIG_CGROUP_DEBUG=y
CONFIG_BLK_DEV_INITRD=y
CONFIG_CC_OPTIMIZE_FOR_SIZE=y
# CONFIG_SYSFS_SYSCALL is not set
CONFIG_KALLSYMS_ALL=y
CONFIG_EMBEDDED=y
CONFIG_PROFILING=y
# CONFIG_MACH_SUN4I is not set
# CONFIG_MACH_SUN5I is not set
# CONFIG_MACH_SUN6I is not set
# CONFIG_MACH_SUN7I is not set
# CONFIG_MACH_SUN9I is not set
# CONFIG_VDSO is not set
CONFIG_HAVE_ARM_ARCH_TIMER=y
CONFIG_ARM_PSCI=y
CONFIG_OABI_COMPAT=y
CONFIG_HIGHMEM=y
# CONFIG_ARM_MODULE_PLTS is not set
# CONFIG_ATAGS is not set
CONFIG_CMDLINE="earlyprintk=sunxi-uart,0x01c28000 loglevel=8 initcall_debug=1 console=ttyS0 init=/init"
CONFIG_VFP=y
CONFIG_NEON=y
CONFIG_PM_WAKELOCKS=y
CONFIG_PM_DEBUG=y
CONFIG_PM_ADVANCED_DEBUG=y
CONFIG_JUMP_LABEL=y
CONFIG_MODULES=y
CONFIG_MODULE_UNLOAD=y
CONFIG_AW_BSP=y
CONFIG_AW_SOC_NAME="V851SE"
CONFIG_AW_TIMER=y
CONFIG_AW_DMA=y
CONFIG_AW_RTC=y
CONFIG_AW_RTC_REBOOT_FLAG=y
CONFIG_AW_RTC_POWEROFF_ALARM=y
# CONFIG_AW_DUMP_REG is not set
CONFIG_AW_WATCHDOG=y
CONFIG_AW_IOMMU=y
CONFIG_AW_MBUS_SUN8IW21=y
CONFIG_AW_MMC_HSQ=y
CONFIG_AW_MMC=y
CONFIG_AW_SYS_INFO=y
CONFIG_AW_SMC=y
CONFIG_AW_GMAC=y
CONFIG_AW_EPHY=y
CONFIG_USB_EHCI_HCD_SUNXI=y
CONFIG_USB_OHCI_HCD_SUNXI=y
CONFIG_USB_SUNXI_HCD=y
CONFIG_USB_SUNXI_HCI=y
CONFIG_USB_SUNXI_EHCI0=y
CONFIG_USB_SUNXI_OHCI0=y
CONFIG_USB_SUNXI_USB=y
CONFIG_USB_SUNXI_USB_MANAGER=y
CONFIG_USB_SUNXI_USB_DEBUG=y
CONFIG_USB_SUNXI_USB_ADB=y
CONFIG_USB_SUNXI_UDC0=y
CONFIG_AW_TWI=y
CONFIG_AW_SPI_NG=y
CONFIG_AW_PWM=y
CONFIG_AW_WAKEUPGEN=y
# CONFIG_AW_STANDBY_DEBUG is not set
CONFIG_NVMEM_AW_SID=y
CONFIG_AW_REGULATOR_PWM=y
CONFIG_AW_HWSPINLOCK=y
# CONFIG_AW_NNA_VIP is not set
# CONFIG_AW_NNA_GALCORE is not set
# CONFIG_CORE_DUMP_DEFAULT_ELF_HEADERS is not set
CONFIG_ZSWAP=y
CONFIG_ZSWAP_DEFAULT_ON=y
# CONFIG_COMPAT_BRK is not set
# CONFIG_COMPACTION is not set
CONFIG_CMA=y
CONFIG_NET=y
CONFIG_PACKET=y
CONFIG_UNIX=y
CONFIG_UNIX_DIAG=y
CONFIG_NET_KEY=y
CONFIG_INET=y
CONFIG_IP_MULTICAST=y
CONFIG_IP_ADVANCED_ROUTER=y
CONFIG_IP_FIB_TRIE_STATS=y
CONFIG_IP_MULTIPLE_TABLES=y
CONFIG_UEVENT_HELPER=y
CONFIG_UEVENT_HELPER_PATH="/sbin/hotplug"
CONFIG_DEVTMPFS=y
# CONFIG_SUNXI_RSB is not set
CONFIG_SCSI=y
CONFIG_BLK_DEV_SD=y
CONFIG_SCSI_DEBUG=y
# CONFIG_INPUT_KEYBOARD is not set
# CONFIG_INPUT_MOUSE is not set
# CONFIG_SERIO is not set
# CONFIG_LEGACY_PTYS is not set
# CONFIG_HW_RANDOM is not set
# CONFIG_DEVMEM is not set
CONFIG_SPI_MEM=y
# CONFIG_PINCTRL_SUN4I_A10 is not set
# CONFIG_PINCTRL_SUN8I_A23 is not set
# CONFIG_PINCTRL_SUN8I_A33 is not set
# CONFIG_PINCTRL_SUN8I_A83T is not set
# CONFIG_PINCTRL_SUN8I_A83T_R is not set
# CONFIG_PINCTRL_SUN8I_A23_R is not set
# CONFIG_PINCTRL_SUN8I_H3 is not set
# CONFIG_PINCTRL_SUN8I_H3_R is not set
# CONFIG_PINCTRL_SUN8I_V3S is not set
CONFIG_POWER_SUPPLY=y
CONFIG_REGULATOR=y
CONFIG_REGULATOR_FIXED_VOLTAGE=y
# CONFIG_MEDIA_CEC_SUPPORT is not set
CONFIG_MEDIA_SUPPORT=y
CONFIG_MEDIA_USB_SUPPORT=y
CONFIG_USB_VIDEO_CLASS=y
CONFIG_SOUND=y
CONFIG_SND=y
CONFIG_SND_SOC=y
CONFIG_USB=y
CONFIG_USB_ANNOUNCE_NEW_DEVICES=y
CONFIG_USB_OTG=y
CONFIG_USB_EHCI_HCD=y
CONFIG_USB_OHCI_HCD=y
CONFIG_USB_ACM=y
CONFIG_USB_STORAGE=y
CONFIG_USB_STORAGE_REALTEK=y
CONFIG_USB_STORAGE_DATAFAB=y
CONFIG_USB_STORAGE_FREECOM=y
CONFIG_USB_STORAGE_ISD200=y
CONFIG_USB_STORAGE_USBAT=y
CONFIG_USB_STORAGE_SDDR09=y
CONFIG_USB_STORAGE_SDDR55=y
CONFIG_USB_STORAGE_JUMPSHOT=y
CONFIG_USB_STORAGE_ALAUDA=y
CONFIG_USB_STORAGE_ONETOUCH=y
CONFIG_USB_STORAGE_KARMA=y
CONFIG_USB_STORAGE_CYPRESS_ATACB=y
CONFIG_USB_STORAGE_ENE_UB6250=y
CONFIG_USB_UAS=y
CONFIG_USB_GADGET=y
CONFIG_USB_CONFIGFS=y
CONFIG_USB_CONFIGFS_SERIAL=y
CONFIG_USB_CONFIGFS_RNDIS=y
CONFIG_USB_CONFIGFS_MASS_STORAGE=y
CONFIG_USB_CONFIGFS_F_FS=y
CONFIG_USB_CONFIGFS_F_HID=y
CONFIG_USB_ROLE_SWITCH=y
CONFIG_MMC=y
# CONFIG_RTC_DRV_SUN6I is not set
CONFIG_DMABUF_HEAPS=y
CONFIG_DMABUF_SYSFS_STATS=y
CONFIG_DMABUF_HEAPS_SYSTEM=y
CONFIG_DMABUF_HEAPS_CMA=y
CONFIG_STAGING=y
# CONFIG_CLK_SUNXI is not set
# CONFIG_SUNXI_CCU is not set
CONFIG_EXT4_FS=y
CONFIG_EXT4_FS_POSIX_ACL=y
CONFIG_EXT4_FS_SECURITY=y
CONFIG_EXT4_DEBUG=y
# CONFIG_DNOTIFY is not set
CONFIG_FUSE_FS=y
CONFIG_VFAT_FS=y
CONFIG_TMPFS=y
CONFIG_TMPFS_POSIX_ACL=y
CONFIG_SQUASHFS=y
CONFIG_SQUASHFS_XZ=y
CONFIG_NLS_CODEPAGE_437=y
CONFIG_NLS_ISO8859_1=y
CONFIG_DMA_CMA=y
CONFIG_PRINTK_TIME=y
CONFIG_FRAME_WARN=2048
CONFIG_MAGIC_SYSRQ=y
CONFIG_DEBUG_FS=y
# CONFIG_SLUB_DEBUG is not set
# CONFIG_SCHED_DEBUG is not set
CONFIG_DEBUG_MUTEXES=y
CONFIG_STACKTRACE=y
# CONFIG_FTRACE is not set
```

## kernel/linux-4.9/drivers/media/platform/sunxi-vin/Kconfig
```kconfig
config CSI_VIN
	tristate "v4l2 new driver for SUNXI"
	default m
	select VIDEOBUF2_DMA_CONTIG

config ENABLE_SENSOR_FLIP_OPTION
	bool "select sensor flip to replace vipp flip"
	default n
	help
	   you cant flip in vipp when you select LBC format,
	   so you can enable it to active sensor flip operation.

config CSI_CCI
	tristate "use cci function"
	default m
	help
		CCI is a hardware module in CSI. you can make it to
		be cci or i2c in the system.

if CSI_CCI
source "drivers/media/platform/sunxi-vin/vin-cci/Kconfig"
endif

config FLASH
	tristate "use flash module"
	default n

config ACTUATOR
	tristate "use actuator module"
	default n

config SENSOR_LIST
	tristate "sensor list for adaptive"
	default n

config BUF_AUTO_UPDATE
	bool "buf addr update for hardware"
	default n

config VIN_LOG
	bool "use vin log for debug"
	default n

config PIPELINE_RESET
	bool "use pipeline reset when timeout"
	default n

config MULTI_FRAME
	bool "multi-frame interrupt mode"
	default n

config SUPPORT_ISP_TDM
	bool "use isp for time sharing multiplex"
	default n

config TDM_LBC_EN
	bool "tdm reduces buf size by compression"
	depends on SUPPORT_ISP_TDM
	default y

config TDM_ONE_BUFFER
	bool "tdm use one buffer mode"
	depends on SUPPORT_ISP_TDM
	default n
	help
		need ensure sensor vbland > 20%

config TDM_ONE_BUFFER_WITH_TWORX
	bool "tdm use one buffer mode with two tdm_rx run"
	depends on TDM_ONE_BUFFER
	default n

config DISPPLAY_SYNC
	bool "use one buffer for delay display"
	default n

config VIN_IOMMU
	bool "use IOMMU for memery alloc"
	default n

config D3D
	bool "ISP 3D denoise module"
	default n

config D3D_LTF_EN
	bool "ISP 3D denoise long time frame"
	depends on D3D
	default n

config D3D_COMPRESS_EN
	bool "ISP 3D denoise reduces buf size by compression"
	depends on D3D
	default	n

config WDR
	bool "ISP WDR module"
	default y

config WDR_COMPRESS_EN
	bool "ISP WDR reduces buf size by compression"
	depends on WDR
	default	n

config FRAMEDONE_TWO_BUFFER
	bool "use two buffer in bk frame done interrupt"
	default	n

config ISP_SERVER_MELIS
	bool "use ISP server from melis"
	default n

config VIN_INIT_MELIS
	bool "vin and isp init in melis"
	depends on ISP_SERVER_MELIS
	default n

config VIDEO_SUNXI_VIN_SPECIAL
	bool "vin is used by other kernel drivers"
	default n

menu "sensor driver select"
source "drivers/media/platform/sunxi-vin/modules/sensor/Kconfig"
endmenu
```

## kernel/linux-4.9/drivers/media/spi/spi-camera/Kconfig
```kconfig
#
# SPI Camera Device Configuration
#

config SPI_CAMERA
	tristate "spi camera framework"
	depends on SPI
	select VIDEOBUF2_DMA_CONTIG
	help
		This is the base framework for SPI camera.
		Say Y when you need to support SPI camera.
		Also SPI need to be selected and
		VIDEOBUF2_DMA_CONTIG will be selected

config SPI_GC032A
	tristate "spi camera gc032a"
	depends on I2C && SPI_CAMERA
	help
		GC032A is a SPI camera.
		Select this  when you need to drive this device
		and SPI_CAMERA also need to be selected.
```

## kernel/linux-4.9/drivers/mtd/awnand/Kconfig
```kconfig
config AW_MTD_SPINAND
	tristate "Allwinner MTD SPINAND Device Support"
	depends on MTD
	depends on ARCH_SUNXI
	select AW_SPINAND_PHYSICAL_LAYER
	select AW_SPINAND_SECURE_STORAGE
	select MTD_UBI
	help
	  Enables support for SPINAND Flash chips on Allwinner SoCs.
	  It's different with Allwinner's privately nand driver that it use
	  ubi system rather than Allwinner's NFTL.

config AW_MTD_RAWNAND
	tristate "Allwinner MTD RAWNAND Device Support"
	depends on MTD
	depends on ARCH_SUNXI
	depends on !SUNXI_NAND
	select AW_RAWNAND_SECURE_STORAGE
	select MTD_UBI
	help
	  Enables support for RAWNAND Flash chips on Allwinner SoCs.
	  It's different with Allwinner's privately nand driver that it use
	  ubi system rather than Allwinner's NFTL.

config RAW_KERNEL
	bool "Kernel images are stored on physical partitions"
	help
	  Enables support kernel images are stored on physical partitions.

config KERNEL_SIZE_BYTE
	int "Kernel image size(Byte)"
	depends on RAW_KERNEL
	default 0
	help
	  To accurately read the complete kernel image, you need to set
	  the kernel image size (in bytes) when using the RAW-boot function.

if AW_MTD_SPINAND
source "drivers/mtd/awnand/spinand/Kconfig"
endif

if AW_MTD_RAWNAND
source "drivers/mtd/awnand/rawnand/Kconfig"
endif
```

## tina/brandy/brandy-2.0/u-boot-2018/configs/sun8iw21p1_64M_defconfig
```kconfig
CONFIG_ARM=y
CONFIG_ARM_SMCCC=y
CONFIG_SUNXI_ARM_SOFT_FP=y
CONFIG_SYS_TEXT_BASE=0x42000000
CONFIG_SUNXI_SECURE_BOOT=y
# CONFIG_SUNXI_INITRD_ROUTINE is not set
CONFIG_MACH_SUN8IW21=y
CONFIG_SUNXI_FDT_ADDR=0x41800000
CONFIG_I2C4_ENABLE=y
CONFIG_DEFAULT_DEVICE_TREE="sun8iw21p1-soc-system"
# CONFIG_SYS_MALLOC_CLEAR_ON_INIT is not set
CONFIG_ANDROID_BOOT_IMAGE=y
# CONFIG_PRE_CONSOLE_BUFFER is not set
CONFIG_CONSOLE_MUX=y
CONFIG_RESERVE_FDT_SIZE=0x20000
CONFIG_SUNXI_KEYBOX=y
CONFIG_SUNXI_MALLOC_LEN=0x1400000
CONFIG_SUNXI_DRM_SUPPORT=y
CONFIG_SUNXI_EXTERN_SECURE_MM_LAYOUT=y
CONFIG_SUNXI_NECESSARY_REPLACE_FDT=y
CONFIG_SUNXI_HOMLET=y
CONFIG_SUNXI_HDCP_IN_SECURESTORAGE=y
CONFIG_CMD_FASTBOOT=y
CONFIG_CMD_PART=y
CONFIG_CMD_FAT=y
CONFIG_CMD_SUNXI_TIMER=y
CONFIG_CMD_SUNXI_CLK=y
CONFIG_CMD_SUNXI_SPRITE=y
CONFIG_CMD_SUNXI_BURN=y
CONFIG_CMD_SUNXI_DMA=y
CONFIG_CMD_SUNXI_MEMTEST=y
CONFIG_CMD_SUNXI_BOOTR=y
CONFIG_SUNXI_ENV_BACKUP=y
CONFIG_CLK_SUNXI=y
CONFIG_SUNXI_GPIO_V2=y
CONFIG_SYS_I2C_SUNXI=y
CONFIG_SYS_SUNXI_I2C4_SPEED=400000
CONFIG_SYS_SUNXI_I2C4_SLAVE=0x34
CONFIG_AXP2101_SUNXI_I2C_SLAVE=0x34
CONFIG_MMC=y
CONFIG_SPI_FLASH=y
CONFIG_SF_DEFAULT_MODE=0x3000
CONFIG_SF_DEFAULT_SPEED=50000000
CONFIG_SPI_SAMP_DL_EN=y
CONFIG_SPI_FLASH_ATMEL=y
CONFIG_SPI_FLASH_EON=y
CONFIG_SPI_FLASH_GIGADEVICE=y
CONFIG_SPI_FLASH_ISSI=y
CONFIG_SPI_FLASH_MACRONIX=y
CONFIG_SPI_FLASH_SPANSION=y
CONFIG_SPI_FLASH_STMICRO=y
CONFIG_SPI_FLASH_SST=y
CONFIG_SPI_FLASH_WINBOND=y
CONFIG_SPI_FLASH_XMC=y
CONFIG_SPI_FLASH_PUYA=y
CONFIG_SPI_FLASH_FM=y
CONFIG_SPI_FLASH_XT=y
CONFIG_SPI=y
CONFIG_SUNXI_SPI=y
CONFIG_SPI_USE_DMA=y
CONFIG_SUNXI_POWER=y
CONFIG_SUNXI_PMU=y
CONFIG_SUNXI_BMU=y
CONFIG_AXP2101_POWER=y
CONFIG_SUNXI_NAND=y
CONFIG_SUNXI_UBIFS=y
CONFIG_SUNXI_COMM_NAND_V1=y
CONFIG_SPINOR_LOGICAL_SECURE_OFFSET=2200
CONFIG_SUNXI_SDMMC=y
CONFIG_SUNXI_USB=y
CONFIG_SUNXI_EFEX=y
CONFIG_SUNXI_BURN=y
CONFIG_SUNXI_CE_23=y
CONFIG_SUNXI_SPRITE=y
CONFIG_SUNXI_SECURE_STORAGE=y
CONFIG_SUNXI_SPRITE_CARTOON=y
```
