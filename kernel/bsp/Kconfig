## kernel/bsp/Kconfig
```kconfig
# SPDX-License-Identifier: GPL-2.0

menu "Allwinner Platform Drivers"

source "bsp/platform/Kconfig"
source "bsp/platform/Kconfig.debug"
source "bsp/drivers/Kconfig"

endmenu
```

## kernel/bsp/drivers/Kconfig
```kconfig
# SPDX-License-Identifier: GPL-2.0-only

menu "Device Drivers"

# Minimal System
source "bsp/drivers/clk/Kconfig"
source "bsp/drivers/pinctrl/Kconfig"
source "bsp/drivers/uart/Kconfig"
source "bsp/drivers/timer/Kconfig"

# Basic System
source "bsp/drivers/dma/Kconfig"
source "bsp/drivers/rtc/Kconfig"
source "bsp/drivers/dumpreg/Kconfig"
source "bsp/drivers/watchdog/Kconfig"
source "bsp/drivers/iommu/Kconfig"
source "bsp/drivers/mbus/Kconfig"

# Storage
source "bsp/drivers/mmc/Kconfig"
source "bsp/drivers/redeposit/Kconfig"

# Graphics
source "bsp/drivers/video/Kconfig"
source "bsp/drivers/g2d/Kconfig"
source "bsp/drivers/di/Kconfig"

# Multi-Media
source "bsp/drivers/ve/Kconfig"

# Security
source "bsp/drivers/ce/Kconfig"
source "bsp/drivers/smc/Kconfig"
source "bsp/drivers/sid/Kconfig"

# I/O Connectivity
source "bsp/drivers/gmac/Kconfig"
source "bsp/drivers/usb/Kconfig"
source "bsp/drivers/twi/Kconfig"
source "bsp/drivers/spi/Kconfig"
source "bsp/drivers/spi-ng/Kconfig"
source "bsp/drivers/pwm/Kconfig"

# Wireless
source "bsp/drivers/net/Kconfig"
source "bsp/drivers/bluetooth/Kconfig"

# Power Management
source "bsp/drivers/irqchip/Kconfig"
source "bsp/drivers/standby/Kconfig"
source "bsp/drivers/thermal/Kconfig"
source "bsp/drivers/nvmem/Kconfig"
source "bsp/drivers/pm_domain/Kconfig"
source "bsp/drivers/power/Kconfig"
source "bsp/drivers/cpufreq/Kconfig"

# AMP/XPU
source "bsp/drivers/msgbox/Kconfig"
source "bsp/drivers/hwspinlock/Kconfig"
source "bsp/drivers/remoteproc/Kconfig"
source "bsp/drivers/rpmsg/Kconfig"
source "bsp/drivers/rpbuf/Kconfig"
source "bsp/drivers/npu/Kconfig"

# Misc
source "bsp/drivers/misc/Kconfig"

# pstore
source "bsp/drivers/pstore/Kconfig"

endmenu
```

## kernel/bsp/drivers/ce/Kconfig
```kconfig
# SPDX-License-Identifier: GPL-2.0-only

comment"Choose one according to the actual usage"

menu "CE Drivers"
	depends on AW_BSP

config AW_CE_SOCKET
	tristate "Support socket AF_ALG API for CE"
	help
	  Allwinner Sunxi SoC provides the CryptoEngine encryption accelerator
	  with socket AF_ALG API. Select this if you want to use it.

config AW_CE_IOCTL
	tristate "CE support the systemcall interface for user api"
	help
	  Allwinner Sunxi SoC provides the CryptoEngine encryption accelerator
	  in IOCTL mode. Select this if you want to use it.

endmenu
```

## kernel/bsp/drivers/clk/sunxi-ng/Kconfig
```kconfig
# SPDX-License-Identifier: GPL-2.0-only
config AW_CCU
	tristate "Clock Support for Allwinner SoCs"
	depends on AW_BSP
	default y
	select RESET_CONTROLLER
	select AW_RTC_CCU

config AW_DDR_CCU
	tristate "DDR_CCU"
	default AW_CCU
	depends on AW_CCU

config AW_SUN8IW20_CCU
	tristate "SUN8IW20 CCU"
	default ARCH_SUN8IW20
	depends on AW_CCU

config AW_SUN8IW20_R_CCU
	tristate "SUN8IW20 PRCM CCU"
	default ARCH_SUN8IW20
	depends on AW_CCU

config AW_SUN8IW20_TEST
	tristate "SUN8IW20 TEST CCU"
	default n
	depends on AW_CCU

config AW_SUN8IW21_CCU
	tristate "SUN8IW21 CCU"
	default ARCH_SUN8IW21
	depends on AW_CCU

config AW_SUN8IW21_R_CCU
	tristate "SUN8IW21 PRCM CCU"
	default ARCH_SUN8IW21
	depends on AW_CCU

config AW_RTC_CCU
	tristate "RTC domain clocks"
	default y
	help
	  sunxi clock provider in RTC domain, which provides clocks such as
	  dcxo24M-out, iosc, osc32k, osc32k-out and rtc-1k. This module is
	  mandatory for sunxi SoCs. Say 'Y' here.
```

## kernel/bsp/drivers/g2d/Kconfig
```kconfig
# SPDX-License-Identifier: GPL-2.0

menu "G2D Drivers"
	depends on AW_BSP

config AW_G2D
	tristate "G2D Support for Allwinner SoCs"
	default n
	help
	  Enable sunxi platform 2D Graphics engine
	  
choice
	prompt "G2D driver version"
	depends on AW_G2D

config G2D_RCQ
	bool "RCQ version"

config G2D_MIXER
	depends on G2D_RCQ
	bool "sunxi g2d mixer module"
	default y
	help
	  Choose Y to enable mixer module of g2d

config G2D_ROTATE
	depends on G2D_RCQ
	bool "sunxi g2d rotate module"
	default y
	help
	  Choose Y to enable rotate module of g2d


endchoice

config G2D_SYNCFENCE
	depends on AW_G2D
	select SYNC_FILE
	bool "sunxi sync fence implement for rotate jobs synchronous"
	default n
	help
	  Choose Y to enable sync fence implement for sunxi G2D

config G2D_USE_HWSPINLOCK
	depends on AW_G2D && AW_RPROC_FAST_BOOT
	bool "sunxi g2d use hwspinlock"
	default n
	help
	  Choose Y to use hwspinlock by sunxi G2D

endmenu
```

## kernel/bsp/drivers/net/wireless/Kconfig
```kconfig
menu "Wireless LAN"
	depends on !S390
	depends on NET

if WLAN
source "bsp/drivers/net/wireless/xr829/Kconfig"
source "bsp/drivers/net/wireless/aic8800/Kconfig"
endif

endmenu
```

## kernel/bsp/drivers/net/wireless/aic8800/Kconfig
```kconfig
config AIC_WLAN_SUPPORT
	bool "AIC wireless Support"
	default n
	help
	  This is support for aic wireless chip.

choice
	prompt "Enable Chip Interface"
	depends on AIC_WLAN_SUPPORT
	help
		Enable Chip Interface.
config AIC_INTF_SDIO
		bool "SDIO interface support"
		depends on AIC_WLAN_SUPPORT && MMC
config AIC_INTF_USB
		bool "USB interface support"
		depends on AIC_WLAN_SUPPORT && USB
endchoice

config USB_MSG_EP
	bool "Enable usb message endpoint"
	default y if AIC_INTF_USB
	depends on AIC_INTF_USB
	help
	  This would enable usb message endpoint

if AIC_WLAN_SUPPORT
source "bsp/drivers/net/wireless/aic8800/aic8800_fdrv/Kconfig"
source "bsp/drivers/net/wireless/aic8800/aic8800_btlpm/Kconfig"
endif

if AIC_INTF_USB
source "bsp/drivers/net/wireless/aic8800/aic8800_btusb/Kconfig"
endif
```

## kernel/bsp/drivers/npu/aw_nna_galcore/Kconfig
```kconfig
# SPDX-License-Identifier: GPL-2.0

config AW_NNA_GALCORE
	depends on (ARCH_SUNXI)
	tristate "aw nna galcore driver"
	default m
	help
	 Choose Y to enable aw nna galcore driver
```

## kernel/bsp/drivers/npu/aw_nna_vip/Kconfig
```kconfig
# SPDX-License-Identifier: GPL-2.0

config AW_NNA_VIP
	depends on (ARCH_SUNXI)
	tristate "aw nna vip driver"
	default m
	select DMA_SHARED_BUFFER
	help
	 Choose Y to enable aw nna vip driver
```

## kernel/bsp/drivers/pinctrl/Kconfig
```kconfig
# SPDX-License-Identifier: GPL-2.0-only
menu "Pinctrl Drivers"
	depends on AW_BSP

config AW_PINCTRL
	tristate "Pinctrl Support for Allwinner SoCs"
	depends on AW_BSP
	select PINMUX
	select GENERIC_PINCONF
	select IRQ_DOMAIN_HIERARCHY
	select GPIOLIB
	default y

config AW_PINCTRL_DEBUGFS
	tristate "Pinctrl Debugfs Driver"
	depends on AW_PINCTRL && DEBUG_FS
	default n

config AW_PINCTRL_SUN8IW20
	tristate "SUN8IW20 PIO"
	depends on AW_PINCTRL
	default ARCH_SUN8IW20 || ARCH_SUN20IW1

config AW_PINCTRL_SUN8IW21
	tristate "SUN8IW21 PIO"
	depends on AW_PINCTRL
	default ARCH_SUN8IW21

config AW_PINCTRL_AXP22X
	tristate "X-Powers AXP221s/223 PMIC pinctrl and GPIO Support"
	depends on AW_PINCTRL
	depends on AW_MFD_AXP2101
	help
	  AXP PMICs provides multiple GPIOs that can be muxed for different
	  functions. This driver bundles a pinctrl driver to select the function
	  muxing and a GPIO driver to handle the GPIO when the GPIO function is
	  selected.
	  Say yes to enable pinctrl and GPIO support for the AXP221s/223 PMIC

config AW_PINCTRL_LEDS
        tristate "Support GPIO leds for sunxi socs"
	help
	  This enables support for GPIO LEDs on Allwinner SoCs.

endmenu
```

## kernel/bsp/drivers/power/Kconfig
```kconfig
# SPDX-License-Identifier: GPL-2.0-only
#
# PMIC drivers configuration
#

menu "PMIC Drivers"
	depends on AW_BSP

config AW_MFD_AXP2101
	tristate
	select MFD_CORE
	select REGMAP_IRQ
	select HAS_IOMEM

config AW_MFD_AXP2101_I2C
	tristate "X-POWERS AXP2101 PMICs with I2C"
	depends on AW_TWI
	select AW_MFD_AXP2101
	select REGMAP_I2C
	select I2C
	help
	  If you say Y here you get support for the X-Powers AXP2101 power
	  management ICs (PMICs) controlled with I2C.
	  This driver include only the core APIs. You have to select individual
	  components like regulators or the PEK (Power Enable Key) under the
	  corresponding menus.

config AW_MFD_PMU_EXT
	tristate
	select MFD_CORE
	select REGMAP
	select REGMAP_IRQ

config AW_MFD_PMU_EXT_I2C
	tristate "PMU_EXT PMICs with I2C"
	depends on AW_TWI
	select AW_MFD_PMU_EXT
	select REGMAP_I2C
	select I2C
	help
	  If you say yes here you get support for the TCS4838 series of
	  PM chips with I2C interface.

config AW_MFD_BMU_EXT
	tristate
	select MFD_CORE
	select REGMAP
	select REGMAP_IRQ

config AW_REGULATOR_BMU_EXT
	tristate

config AW_MFD_BMU_EXT_I2C
	tristate "BMU_EXT PMICs with I2C"
	depends on AW_TWI
	select AW_MFD_BMU_EXT
	select AW_REGULATOR_BMU_EXT
	select REGMAP_I2C
	select I2C
	help
	  If you say yes here you get support for the TCS4838 series of
	  PM chips with I2C interface.

comment "Regulator Drivers"

if AW_MFD_AXP2101

config AW_REGULATOR_AXP2101
	tristate "X-POWERS AXP2101 PMIC Regulators"
	depends on AW_MFD_AXP2101
	select REGULATOR
	select REGULATOR_VIRTUAL_CONSUMER
	help
	  This driver provides support for the voltage regulators on the
	  AXP2101 PMIC.
endif

if AW_MFD_PMU_EXT

config AW_REGULATOR_PMU_EXT
	tristate "PMU_EXT Power regulator"
	depends on AW_MFD_PMU_EXT
	select REGULATOR
	help
	  This driver provides support for the voltage regulators on the
	  PMU_EXT PMIC.

endif

config AW_REGULATOR_PWM
	tristate "SUNXI PWM voltage regulator"
	depends on PWM
	help
	  This driver supports PWM controlled voltage regulators. PWM
	  duty cycle can increase or decrease the voltage.

comment "Powerkey Drivers"

if AW_MFD_AXP2101

config AW_INPUT_AXP2101_PEK
	tristate "X-POWERS AXP2101 Power Button Driver"
	depends on !UML
	depends on AW_MFD_AXP2101
	help
	  Say Y here if you want to enable power key reporting via the
	  AXP20X PMIC.

	  To compile this driver as a module, choose M here. The module will
	  be called axp2101-pek.

endif

comment "Power Supply Drivers"

if AW_MFD_AXP2101

config AW_AXP803_POWER
	tristate "AXP803 Power Supply Driver"
	select POWER_SUPPLY
	help
	  This driver provides support for the power supply features of
	  AXP803 PMIC.

config AW_AXP2202_POWER
	tristate "AXP2202 Power Supply Driver"
	select POWER_SUPPLY
	help
	  This driver provides support for the power supply features of
	  AXP2202 PMIC.

config AW_AXP2202_GPIO_POWER
	tristate "AXP2202 Power Virtual ACIN"
	select POWER_SUPPLY
	help
	  This driver provides support for ACIN function in
	  AXP2202 PMIC.

config AW_AXP22X_POWER
	tristate "AXP22X Power Supply Driver"
	select POWER_SUPPLY
	help
	  This driver provides support for the power supply features of
	  AXP221/AXP223 PMIC.
endif

if AW_MFD_BMU_EXT

config AW_ETA6973_POWER
	tristate "ETA6973 Power Supply Driver"
	depends on AW_MFD_BMU_EXT
	select POWER_SUPPLY
	help
	  This driver provides support for the power supply features of
	  ETA6973 PMIC.

config AW_AXP519_POWER
	tristate "AXP519 Power Supply Driver"
	depends on AW_MFD_BMU_EXT
	select POWER_SUPPLY
	help
	  This driver provides support for the power supply features of
	  AXP519 PMIC.

config AW_AXP2601_POWER
	tristate "AXP2601 Power Supply Driver"
	depends on AW_MFD_BMU_EXT
	select POWER_SUPPLY
	help
	  This driver provides support for the power supply features of
	  AXP2601 PMIC.

endif

endmenu
```

## kernel/bsp/drivers/sid/Kconfig
```kconfig
# SPDX-License-Identifier: GPL-2.0-only

menu "SID Drivers"
	depends on AW_BSP

config AW_SID
	tristate "Allwinner SID Support"
	default n
	help
	 Say Y here to enable the sunxi SID support.

endmenu
```

## kernel/bsp/drivers/spi-ng/Kconfig
```kconfig
# SPDX-License-Identifier: GPL-2.0-or-later

menu "SPI NG Drivers"
	depends on AW_BSP

config AW_SPI_NG
	tristate "SPI NG Driver Support for Allwinner SoCs"
	depends on OF
	default n
	select SPI
	help
	  Enable SPI Next Generation Driver Support for Allwinner SoCs.

config AW_SPI_NG_ATOMIC_XFER
	bool "Support atomic xfer function"
	depends on AW_SPI_NG
	default n
	help
	  Enable SPI controller atomic xfer function, support transfer under
	  no-irq/no-dma/no-schedule/no-suspend-resume env. (Such as kernel panic)

config AW_SPI_SLAVETEST
	tristate "SPI Slave Test Driver"
	depends on AW_SPI_NG
	default n
	select SPI_SLAVE
	help
	  Enable SPI Slave Test Driver.

endmenu
```

## kernel/bsp/drivers/thermal/Kconfig
```kconfig
# SPDX-License-Identifier: GPL-2.0-only
menu "Thermal Drivers"
	depends on AW_BSP

config AW_THERMAL
	tristate "Allwinner Thermal Driver"
	depends on AW_BSP
	depends on HAS_IOMEM
	depends on NVMEM
	depends on OF
	select THERMAL
	help
	  Support for the sunxi thermal sensor driver into the Linux thermal
	  framework.

	  To compile this driver as a module, choose M here: the
	  module will be called sunxi-thermal.

config AW_THERMAL_CRITICAL_SUSPEND
	bool "suspend to handle critical temperature"
	default n
	depends on AW_THERMAL
	depends on PM_SLEEP
	help
	  Support critical callback for the thermal zone device ops.
	  Trigger suspend when the temperature reachs the critical trip.

endmenu
```

## kernel/bsp/drivers/timer/Kconfig
```kconfig
# SPDX-License-Identifier: GPL-2.0-only
menu "Timer Drivers"
	depends on GENERIC_CLOCKEVENTS
	depends on AW_BSP

config AW_TIMER
	tristate "Timer support for Allwinner SoCs"
	depends on HAS_IOMEM
	select CLKSRC_MMIO
	select TIMER_OF
	help
	  Enables support for the Sun4i timer.

config AW_TIMER_SUN50I
	tristate "Timer support for Allwinner Sun50i SoCs"
	depends on HAS_IOMEM
	select CLKSRC_MMIO
	select TIMER_OF
	help
	  Enables support for the Sun50i timer.

endmenu
```

## kernel/bsp/drivers/usb/typec/mux/Kconfig
```kconfig
# SPDX-License-Identifier: GPL-2.0

menu "USB Type-C Multiplexer/DeMultiplexer Switch support"

config TYPEC_MUX_PS8743
	tristate "Parade PS8743 Type-C cross switch driver"
	depends on USB_SUNXI_TYPEC
	depends on I2C
	help
	  Say Y or M if your system has a Parade PS8743 Type-C cross
	  switch / mux chip found on some devices with a Type-C port.

          If unsure, say N.

endmenu
```

## kernel/bsp/platform/Kconfig
```kconfig
# SPDX-License-Identifier: GPL-2.0-only

source "bsp/platform/Kconfig.common"

menu "Platform Selection"

config AW_BSP
	bool "Allwinner Platform"
	select ARCH_SUNXI
	select ARCH_HAS_RESET_CONTROLLER
	select GENERIC_IRQ_CHIP
	select PINCTRL
	select RESET_CONTROLLER
	help
	  This enables support for Allwinner sunxi based SoCs like the A64.

choice

	prompt "Select SoC Family"
	default ARCH_SUN8I  if ARM
	depends on AW_BSP
	help
	  Select the Family for SoC

config ARCH_SUN8I
	bool "Allwinner SUN8I"
	depends on AW_BSP && ARM
	help
	  Allwinner SUN8I SoC Family

endchoice

choice
	prompt "Select the Wafer"
	default ARCH_SUN8IW21
	depends on AW_BSP
	help
	  Select the wafer

config ARCH_SUN8IW20
	bool "SUN8IW20"
	depends on ARCH_SUN8I
	help
	  Support for Allwinner SUN8IW20 SoC

config ARCH_SUN8IW21
	bool "SUN8IW21"
	depends on ARCH_SUN8I
	help
	  Support for Allwinner SUN8IW21 SoC

endchoice

choice
	prompt "Select the Board"
	depends on AW_BSP
	default AW_IC_BOARD

config AW_IC_BOARD
	bool "IC Board"
	help
	  Support for Allwinner IC board
endchoice

config AW_SOC_NAME
	string "SoC Name"
	default ""
	depends on AW_BSP
	help
	  Used by sysfs: /sys/.../sysinfo

endmenu
```
